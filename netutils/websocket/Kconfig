## netutils/websocket/Kconfig
```kconfig
#
# For a description of the syntax of this configuration file,
# see kconfig-language at https://www.kernel.org/doc/Documentation/kbuild/kconfig-language.txt
#

config NETUTILS_WEBSOCKET
	bool "uIP Web socket"
	default n
	depends on NET_TCP
	---help---
		Enable support for the web socket.
		
```

## uORB/Kconfig
```kconfig
#
# For a description of the syntax of this configuration file,
# see the file kconfig-language.txt in the NuttX tools repository.
#

config UORB
	bool "Micro Object Request Broker(uORB)"
	default n
	depends on HAVE_CXX
	---help---
		Enable the micro object request broker(uORB)

if UORB

config UORB_CXXINITIALIZE
	bool "C++ Initialization"
	default y
	depends on HAVE_CXX && HAVE_CXXINITIALIZE
	---help---
		By default, if CONFIG_HAVE_CXX and CONFIG_HAVE_CXXINITIALIZE are
		defined, then this example will call the NuttX function to
		initialize static C++ constructors.  This option may be disabled,
		however, if that static initialization was performed elsewhere.

endif
```
